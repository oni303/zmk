## app/boards/shields/corneL/Kconfig.shield
```kconfig
# Copyright (c) 2020 Pete Johanson
# SPDX-License-Identifier: MIT

config SHIELD_CORNEL_LEFT
	def_bool $(shields_list_contains,corneL_left)

config SHIELD_CORNEL_RIGHT
	def_bool $(shields_list_contains,corneL_right)
```
